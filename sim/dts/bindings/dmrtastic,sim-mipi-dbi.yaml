## sim/dts/bindings/dmrtastic,sim-mipi-dbi.yaml
```yaml
description: Simulated MIPI DBI controller that calls the HX8353E model directly.

compatible: "dmrtastic,sim-mipi-dbi"

include: mipi-dbi-controller.yaml
```

## sim/dts/bindings/dmrtastic,sim-pwm.yaml
```yaml
description: Simulated PWM controller that accepts any duty cycle.

compatible: "dmrtastic,sim-pwm"

include: [pwm-controller.yaml, base.yaml]

properties:
  "#pwm-cells":
    const: 3

pwm-cells:
  - channel
  - period
  - flags
```

## sim/dts/bindings/dmrtastic,sim-spi-nor.yaml
```yaml
description: Simulated SPI NOR flash with JEDEC ID readback.

compatible: "dmrtastic,sim-spi-nor"

include: base.yaml

properties:
  size:
    type: int
    required: true
    description: Capacity in bytes.

  jedec-id:
    type: uint8-array
    required: true
    description: Manufacturer, memory type and capacity bytes.
```

## sim/dts/bindings/dmrtastic,sim-wdt.yaml
```yaml
description: Simulated watchdog that never expires.

compatible: "dmrtastic,sim-wdt"

include: base.yaml
```

## subsys/radio/Kconfig
```kconfig
# Copyright (c) 2026 Andrew Yong <me@ndoo.sg>
# SPDX-License-Identifier: MIT

config RADIO_MANAGER
	bool "Handheld-transceiver radio manager"
	default n
	depends on DT_HAS_HT_RADIO_ENABLED
	depends on RADIO_AT1846S
	help
	  Orchestration layer above the RF transceiver and (optionally) DMR
	  baseband drivers. Owns board-level PA/LNA/audio-amp/mic-power
	  GPIOs, applies TX frequency-offset compensation, and drives TX
	  power via the DAC channel described on the ht,radio device tree
	  node.

if RADIO_MANAGER

config RADIO_MANAGER_INIT_PRIORITY
	int "Init priority"
	default 85
	range 50 89

module = RADIO_MANAGER
module-str = radio_mgr
source "subsys/logging/Kconfig.template.log_config"

endif # RADIO_MANAGER
```

## subsys/radio/dts/bindings/radio/ht,radio.yaml
```yaml
# Copyright (c) 2026 Andrew Yong <me@ndoo.sg>
# SPDX-License-Identifier: MIT

description: |
  Board-level handheld-transceiver radio orchestrator. Ties together one
  RF transceiver, an optional baseband modem, and the discrete GPIOs and
  DAC channels for PA, LNA, audio amplifier, microphone power, and
  speaker mute. Used by the radio manager subsystem.

compatible: "ht,radio"

properties:
  transceiver:
    type: phandle
    required: true
    description: phandle to the RF transceiver device node (e.g. AT1846S).

  baseband:
    type: phandle
    description: |
      phandle to the baseband modem device node (e.g. HR-C6000). Omit on
      FM-only radios that use the transceiver standalone.

  vhf-lna-gpios:
    type: phandle-array
    description: VHF receive LNA path enable. Asserted during VHF RX only.

  uhf-lna-gpios:
    type: phandle-array
    description: UHF receive LNA path enable. Asserted during UHF RX only.

  pa-enable-1-gpios:
    type: phandle-array
    description: PA stage 1 enable.

  pa-enable-2-gpios:
    type: phandle-array
    description: PA stage 2 / APC enable.

  pa-band-select-gpios:
    type: phandle-array
    description: |
      PA band select. Cell flags determine the active polarity. Omit on
      single-band radios.

  mic-power-gpios:
    type: phandle-array
    description: Microphone bias power switch.

  audio-amp-enable-gpios:
    type: phandle-array
    description: Speaker amplifier enable.

  speaker-mute-gpios:
    type: phandle-array
    description: |
      Speaker mute (separate from amp enable). The cell's polarity flag
      determines the active state.

  tx-freq-offset-narrow-hz:
    type: int
    default: 0
    description: |
      TX frequency offset applied for 12.5 kHz channel spacing to
      compensate systematic VCO pull.

  tx-freq-offset-wide-hz:
    type: int
    default: 0
    description: |
      TX frequency offset applied for 25 kHz channel spacing.

  tx-power-dac:
    type: phandle-array
    description: |
      DAC channel used for TX power control. Some boards use the same
      DAC channel for VHF RX band tuning at idle; the radio manager
      switches the value at TX/RX transitions.

  rx-vhf-tuning-dac:
    type: phandle-array
    description: |
      Optional separate DAC channel for VHF RX band tuning. Omit if the
      same channel as tx-power-dac is reused.
```

## zephyr/dts/bindings/misc/ht-radio,codeplug-map.yaml
```yaml
# Copyright (c) 2026 Andrew Yong <me@ndoo.sg>
# SPDX-License-Identifier: MIT

description: |
  Named region map for a radio's persistent-configuration flash chip
  (channels, contacts, zones, settings, calibration, etc). Each property is
  an <offset size> pair, byte offsets into the flash device referenced by
  codeplug-flash. Properties are all optional: a board only declares the
  regions its own flash layout actually has, so the same binding schema
  covers radios with different flash sizes or region sets without any
  schema change -- only the property values differ per board.

compatible: "ht-radio,codeplug-map"

properties:
  codeplug-flash:
    type: phandle
    required: true
    description: The flash device these region offsets are relative to.

  device-info:
    type: array
    description: Model/serial/firmware-version block.

  general-settings:
    type: array
    description: Radio name, radio ID, basic radio parameters.

  signalling-dtmf:
    type: array
    description: DTMF signalling configuration.

  signalling-dtmf-durations:
    type: array
    description: |
      DTMF timing sub-block (first/other digit duration, rate, tail).
      Independently addressed, not a slice of signalling-dtmf.

  aprs-configs:
    type: array
    description: APRS configuration entries.

  dtmf-contacts:
    type: array
    description: DTMF contact list.

  channels-bank1:
    type: array
    description: First channel bank (in-use bitmask header + channel entries).

  last-used-channel:
    type: array
    description: Last-used-channel-in-zone record.

  nv-settings:
    type: array
    description: |
      On-flash persistent settings block (backlight, timers, last-used
      zone/channel, etc). Magic-numbered; field shape may vary by firmware
      version -- see the reader implementation for handling.

  boot-password:
    type: array
    description: Boot intro-screen flag, password-enable flag, and PIN.

  quickkeys:
    type: array
    description: Quick-key function assignments.

  boot-lines:
    type: array
    description: |
      Two 16-byte boot-screen text lines. boot-password's intro-screen flag
      selects between showing these or the radio's built-in boot picture.

  vfo-channels:
    type: array
    description: VFO A/B channel data.

  zones-ext:
    type: array
    description: Zone in-use bitmap and zone list.

  calibration:
    type: array
    description: Local working copy of the radio's calibration table.

  custom-data:
    type: array
    description: Optional custom-data chain (splash image, beep, theme, ...).

  channels-ext:
    type: array
    description: Additional channel banks beyond channels-bank1.

  contacts:
    type: array
    description: Contact list.

  rx-group-lists:
    type: array
    description: RX group list in-use array and entries.
```
