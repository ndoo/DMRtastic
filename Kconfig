## Kconfig
```kconfig
# Copyright (c) 2026 Andrew Yong <me@ndoo.sg>
# SPDX-License-Identifier: MIT

source "Kconfig.zephyr"
```

## boards/arm/mduv390plus/Kconfig.mduv390plus
```kconfig
# Copyright (c) 2026 Andrew Yong <me@ndoo.sg>
# SPDX-License-Identifier: MIT

config BOARD_MDUV390PLUS
	select SOC_STM32F405XX
	help
	  TYT MD-UV390 PLUS 10W GPS dual-band DMR radio (STM32F405VGT6).
	  Uses a proprietary TYT DFU bootloader; flash with tools/flash_tyt_dfu.py.
```

## boards/arm/mduv390plus/board.yml
```yaml
# Copyright (c) 2026 Andrew Yong <me@ndoo.sg>
# SPDX-License-Identifier: MIT

board:
  name: mduv390plus
  full_name: TYT MD-UV390 PLUS 10W GPS
  vendor: tyt
  socs:
    - name: stm32f405xx
```

## drivers/kbd_matrix_shared_bus/Kconfig
```kconfig
# Copyright (c) 2026 Andrew Yong <me@ndoo.sg>
# SPDX-License-Identifier: Apache-2.0

config INPUT_KBD_MATRIX_SHARED_BUS
	bool "GPIO keyboard matrix sharing pins with another device"
	default y
	depends on DT_HAS_GPIO_KBD_MATRIX_SHARED_BUS_ENABLED
	select INPUT_KBD_MATRIX
	help
	  Keyboard matrix input driver for boards where the sensed (row) GPIOs
	  are time-shared with another peripheral (e.g. a parallel-bus LCD)
	  rather than owned exclusively.

	  Unlike CONFIG_INPUT_GPIO_KBD_MATRIX, this driver has no interrupt or
	  internal polling thread of its own — it never touches the shared
	  pins except during a scan. The application must call
	  kbd_matrix_shared_bus_scan() explicitly, from the same thread that
	  drives the other peripheral sharing the pins, whenever it wants a
	  scan to happen (e.g. once per display refresh). See
	  include/drivers/input/kbd_matrix_shared_bus.h.
```

## drivers/mipi_dbi_fsmc/Kconfig
```kconfig
config MIPI_DBI_STM32_FSMC
	bool "STM32F4 FSMC eight-bit MIPI DBI with DMA"
	default y
	depends on DT_HAS_ST_STM32_FSMC_MIPI_DBI_ENABLED
	depends on SOC_SERIES_STM32F4X
	select MIPI_DBI
	select DMA
	select PINCTRL
	select GPIO
```

## drivers/mipi_dbi_fsmc/dts/bindings/mipi-dbi/st,stm32-fsmc-mipi-dbi.yaml
```yaml
description: |
  STM32F4 FSMC bank 1 driving an eight-bit 8080 LCD through byte accesses.
  RS is an FSMC address line; CS and reset are GPIOs. Pixel transfers use
  memory-to-memory DMA with a fixed destination address.
compatible: "st,stm32-fsmc-mipi-dbi"
include: [mipi-dbi-controller.yaml, pinctrl-device.yaml]
properties:
  reg:
    required: true
  reg-names:
    required: true
    description: FSMC bank registers, command address, and data address
  clocks:
    required: true
  dmas:
    required: true
  dma-names:
    required: true
  cs-gpios:
    type: phandle-array
    required: true
  reset-gpios:
    type: phandle-array
    required: true
  shared-pins:
    type: phandle
    required: true
    description: Ownership lock shared with the keyboard scanner
  address-setup-cycles:
    type: int
    required: true
    description: Address setup duration in HCLK cycles (1 to 16)
  data-setup-cycles:
    type: int
    required: true
    description: Data setup duration in HCLK cycles (1 to 256)
```

## drivers/radio/at1846s/Kconfig
```kconfig
# Copyright (c) 2026 Andrew Yong <me@ndoo.sg>
# SPDX-License-Identifier: MIT

config RADIO_AT1846S
	bool "AT1846S RF transceiver driver"
	default y
	depends on DT_HAS_AUCTUS_AT1846S_ENABLED
	depends on I2C
	help
	  Enable the driver for the Auctus AT1846S single-chip RF
	  transceiver. The driver exposes the radio_trx_api function-pointer
	  table and operates over an I2C bus described in the device tree.
	  i2c_recover_bus() is invoked at init; the platform-specific bus
	  recovery support (e.g. CONFIG_I2C_STM32_BUS_RECOVERY) must be
	  enabled separately in the application's prj.conf.

if RADIO_AT1846S

config RADIO_AT1846S_REGISTER_CACHE
	bool "Register write cache"
	default y
	help
	  Suppress redundant 16-bit register writes by caching the last
	  written value per (register, bank). Disable to force every write
	  to hit the bus, e.g. for bring-up debugging.

config RADIO_AT1846S_INIT_PRIORITY
	int "Driver init priority"
	default 80
	range 50 89
	help
	  POST_KERNEL init priority. Must run after the I2C bus controller
	  (default 70 on Zephyr) and after GPIO (40), and before any
	  consumer that calls into the transceiver.

config RADIO_AT1846S_SQUELCH_STACK_SIZE
	int "Software squelch thread stack size"
	default 512
	help
	  Stack size in bytes for the AT1846S software squelch monitoring
	  thread. The thread polls RSSI every SQUELCH_POLL_MS milliseconds
	  while in FM RX and gates the speaker amp based on the noise byte.
	  Unused in hardware squelch mode (the thread exits immediately).

config RADIO_AT1846S_SQUELCH_POLL_MS
	int "Software squelch polling interval (ms)"
	default 25
	help
	  How often the squelch thread reads AT1846S register 0x1B during
	  FM RX. 25 ms gives 40 samples/s, which is fast enough to track
	  carrier onset without significant CPU overhead.

config RADIO_AT1846S_SQUELCH_PRIO
	int "Software squelch thread priority"
	default 10
	help
	  Zephyr thread priority for the AT1846S squelch monitoring thread.

module = RADIO_AT1846S
module-str = at1846s
source "subsys/logging/Kconfig.template.log_config"

endif # RADIO_AT1846S
```

## drivers/radio/at1846s/dts/bindings/radio/auctus,at1846s.yaml
```yaml
# Copyright (c) 2026 Andrew Yong <me@ndoo.sg>
# SPDX-License-Identifier: MIT

description: |
  Auctus AT1846S single-chip RF transceiver (I2C).

compatible: "auctus,at1846s"

include: [i2c-device.yaml]

properties:
  reg:
    required: true

  freq-ranges:
    type: array
    description: |
      Pairs of (low, high) frequencies in Hz that this transceiver supports.
      Each pair defines one band. Used by the driver to validate
      set_frequency() calls and by the radio manager to derive band
      switching. A typical dual-band MD-UV390 PLUS configuration is:
      <134000000 174000000  400000000 520000000>.

  band-select-gpios:
    type: phandle-array
    description: |
      Optional GPIOs driven HIGH for one band, LOW for the other (and vice
      versa for the second pin) to switch the external front-end band path.
      The driver activates the appropriate pattern at set_frequency() time.

  rx-audio-mux-gpios:
    type: phandle-array
    description: |
      Optional GPIO controlling the FM/digital audio mux. HIGH = AT1846S
      analog FM demodulator output routed to the speaker amp; LOW = digital
      baseband audio path. Asserted by the driver on entry to FM RX mode.

  amp-en-gpios:
    type: phandle-array
    description: Optional speaker amplifier enable. Asserted on FM RX entry.

  spk-mute-gpios:
    type: phandle-array
    description: |
      Optional speaker mute. Polarity is captured via GPIO_ACTIVE_HIGH /
      GPIO_ACTIVE_LOW on the cell; gpio_pin_set_dt(spec, 0) always means
      "unmuted" and gpio_pin_set_dt(spec, 1) means "muted".

  squelch-gpios:
    type: phandle-array
    description: |
      Optional AT1846S GPIO6 output. Goes high when the chip's squelch
      opens (signal above threshold). Wire to an interrupt-capable MCU pin
      for low-latency squelch notification; otherwise the radio manager
      polls RSSI on a timer.

  css-detect-gpios:
    type: phandle-array
    description: |
      Optional AT1846S GPIO1 output. Goes high when CTCSS/DCS conditions
      are met. Wire to an interrupt-capable MCU pin for low-latency CSS
      notification; otherwise the driver polls register 0x1C.

  baseband-handles-deemphasis:
    type: boolean
    description: |
      Set when a companion baseband IC performs FM de-emphasis. Causes the
      driver to disable the AT1846S internal de-emphasis filter.

  baseband-handles-ctcss-dcs:
    type: boolean
    description: |
      Set when a companion baseband IC handles CTCSS/DCS encode/decode.
      Causes the driver's CTCSS/DCS API to become no-ops.

  squelch-mode:
    type: string
    enum: ["hardware", "software"]
    default: "software"
    description: |
      hardware: chip register SQ_THRESH gates audio internally; GPIO6
      mirrors squelch state. Lower MCU overhead but no speaker-mute
      synchronisation unless squelch-gpios is also wired.
      software: SQ_THRESH=0 (chip in monitor mode); the driver spawns a
      squelch thread that polls AT1846S RSSI register 0x1B every
      RADIO_AT1846S_SQUELCH_POLL_MS ms and controls spk-mute-gpios /
      amp-en-gpios directly. Hysteresis of 3 noise units prevents
      squelch chatter.

  tx-freq-offset-hz:
    type: int
    default: 0
    description: |
      Fixed TX frequency offset applied by the driver to compensate
      systematic VCO pull. Default 0; some boards need a few kHz.

  volume-taper:
    type: string
    enum: ["linear", "audio-a"]
    default: "linear"
    description: |
      Which standard taper curve the volume pot follows. Selects one of a
      small set of built-in reverse-mapping lookup tables in the UI layer
      (src/ui/ui.c, see taper_lut_*) that convert the pot's raw 0-100%
      reading back to a perceptually-linear percentage for display only --
      set_volume() always receives the raw value unchanged, since the
      pot's own taper is what gives volume control its natural feel; only
      the overlay/status display is reverse-mapped.

        linear:  identity mapping (no correction); for a linear-taper (B)
                 pot.
        audio-a: standard "A"/audio-log taper, approximated as the common
                 industry two-linear-segment curve ("50% rotation ~= 10-15%
                 of range") rather than a smooth analytic formula -- a
                 pot's real response rarely matches one.

      For a pot that doesn't fit either preset, add a new enum value here
      plus a matching taper_lut_* table in ui.c rather than hand-deriving
      numbers in DTS.
```

## drivers/radio/hr_c6000/Kconfig
```kconfig
# Copyright (c) 2026 Andrew Yong <me@ndoo.sg>
# SPDX-License-Identifier: MIT

config RADIO_HR_C6000
	bool "HR-C6000 DMR baseband driver"
	default n
	depends on DT_HAS_HONGRUI_HR_C6000_ENABLED
	depends on SPI && GPIO
	help
	  Enable the driver for the Hongrui HR-C6000 DMR/FM baseband SoC.
	  The driver exposes the radio_bb_api function-pointer table and
	  drives both a control SPI bus (paged register space) and an
	  optional audio SPI bus for AMBE vocoder frame transfers.

if RADIO_HR_C6000

config RADIO_HR_C6000_INIT_PRIORITY
	int "Driver init priority"
	default 81
	range 50 89
	help
	  POST_KERNEL init priority. Must run after the SPI bus controller
	  and after the AT1846S transceiver (default 80) so the radio
	  manager finds both drivers ready.

module = RADIO_HR_C6000
module-str = hr_c6000
source "subsys/logging/Kconfig.template.log_config"

endif # RADIO_HR_C6000
```

## drivers/radio/hr_c6000/dts/bindings/radio/hongrui,hr-c6000-audio.yaml
```yaml
# Copyright (c) 2026 Andrew Yong <me@ndoo.sg>
# SPDX-License-Identifier: MIT

description: |
  HR-C6000 audio SPI passthrough. Represents the HR-C6000 chip select on
  a separate hardware SPI audio bus dedicated to AMBE vocoder frame
  transfers (chip page 0x03). Carries no custom properties; the node
  exists to satisfy the audio-spi-dev phandle reference on the main
  hr-c6000 node and to provide a spi_dt_spec the HR-C6000 driver can use
  for AMBE reads and writes.

compatible: "hongrui,hr-c6000-audio"

include: [spi-device.yaml]
```

## drivers/radio/hr_c6000/dts/bindings/radio/hongrui,hr-c6000.yaml
```yaml
# Copyright (c) 2026 Andrew Yong <me@ndoo.sg>
# SPDX-License-Identifier: MIT

description: |
  Hongrui HR-C6000 DMR/FM baseband SoC. SPI child device with a paged
  register space (control bus). Voice (AMBE) frames are transferred over
  a separate hardware SPI bus referenced by the audio-spi-dev phandle.

compatible: "hongrui,hr-c6000"

include: [spi-device.yaml]

properties:
  power-down-gpios:
    type: phandle-array
    required: true
    description: |
      Active-low chip power-down control. Drive low to power on, high to
      power down. Polarity is captured via GPIO_ACTIVE_LOW on the cell.

  timeslot-int-gpios:
    type: phandle-array
    required: true
    description: |
      TIME_SLOT_INTER output. Pulses at every 30 ms DMR timeslot boundary.
      Configure the cell flags as edge-triggered.

  sys-int-gpios:
    type: phandle-array
    required: true
    description: |
      SYS_INTER output. Fires on TX start / TX end / received data /
      error events. Configure the cell flags as edge-triggered.

  rftx-int-gpios:
    type: phandle-array
    required: true
    description: |
      RF_TX_INTER output. Signals the MCU to enable the RF PA at the
      start of a TX burst. Configure the cell flags as edge-triggered.

  audio-spi-dev:
    type: phandle
    description: |
      phandle to the companion SPI device on the hardware SPI audio bus,
      used for AMBE vocoder frame transfers. Optional in builds that do
      not yet wire the audio bus; required for any DMR audio.

  if-frequency-hz:
    type: int
    default: 450000
    description: |
      IF frequency presented to the HR-C6000 ADC by the companion RF
      transceiver. Programs internal IF demodulator coefficients.

  rf-recv-mode:
    type: string
    default: "if"
    enum:
      - "if"
      - "iq"
    description: |
      Analog receive path presented to the HR-C6000 ADC. "if" for an IF
      input from a companion superhet; "iq" for I/Q baseband.

  swap-iq-adc:
    type: boolean
    description: Swap ADC I/Q channels (chip RFRecvIQMode bit).

  swap-iq-dac:
    type: boolean
    description: Swap DAC I/Q channels (chip RFTransIQMode bit).
```

## drivers/shared_pins/Kconfig
```kconfig
config SHARED_PINS
	bool "Shared pin ownership"
	default y
	depends on DT_HAS_HT_RADIO_SHARED_PINS_ENABLED
```

## drivers/shared_pins/dts/bindings/misc/ht-radio,shared-pins.yaml
```yaml
description: Mutual exclusion for devices sharing physical pins
compatible: "ht-radio,shared-pins"
include: base.yaml
```

## drivers/spi/spi_bitbang_irq/Kconfig
```kconfig
# Copyright (c) 2026 Andrew Yong <me@ndoo.sg>
# SPDX-License-Identifier: MIT

config SPI_BITBANG_IRQ
	bool "IRQ-safe GPIO SPI bit-bang bus controller"
	default n
	depends on DT_HAS_HT_RADIO_SPI_BITBANG_IRQ_ENABLED
	depends on SPI && GPIO
	help
	  Drop-in replacement for zephyr,spi-bitbang that uses k_spinlock
	  instead of k_sem internally so that spi_transceive() can be
	  called from interrupt context. Property names match the upstream
	  binding exactly; switching back requires only a compatible
	  string change in the device tree.

if SPI_BITBANG_IRQ

config SPI_BITBANG_IRQ_INIT_PRIORITY
	int "Bus init priority"
	default 70
	range 50 89

module = SPI_BITBANG_IRQ
module-str = spi_bitbang_irq
source "subsys/logging/Kconfig.template.log_config"

endif # SPI_BITBANG_IRQ
```

## drivers/spi/spi_bitbang_irq/dts/bindings/spi/ht-radio,spi-bitbang-irq.yaml
```yaml
# Copyright (c) 2026 Andrew Yong <me@ndoo.sg>
# SPDX-License-Identifier: MIT

description: |
  IRQ-safe GPIO SPI bit-bang bus controller.

  Drop-in replacement for zephyr,spi-bitbang where the SPI bus must be
  driven from interrupt context. Internally uses k_spinlock instead of
  k_sem so that spi_transceive() can be called from both thread and ISR
  contexts.

  Property names match zephyr,spi-bitbang exactly so switching back
  requires only a compatible-string change.

compatible: "ht-radio,spi-bitbang-irq"

include: [spi-controller.yaml]

bus: spi

properties:
  clk-gpios:
    type: phandle-array
    required: true
    description: SPI clock GPIO.

  mosi-gpios:
    type: phandle-array
    required: true
    description: SPI MOSI GPIO.

  miso-gpios:
    type: phandle-array
    description: SPI MISO GPIO. Optional for write-only buses.
```
